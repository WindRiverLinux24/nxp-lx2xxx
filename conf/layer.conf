## conf/layer.conf
```bitbake
BBPATH ?= ""
# We have a conf and classes directory, add to BBPATH
BBPATH =. "${LAYERDIR}:"

# We add the *.bbappend to BBFILES. 
BSP_NXP_LX2XXX_DERIVED ??=""
BBFILES += "${@bb.utils.contains('MACHINE', 'nxp-lx2xxx ${BSP_NXP_LX2XXX_DERIVED}', '${LAYERDIR}/recipes-*/*/*.bb', '', d)}"
BBFILES += "${@bb.utils.contains('MACHINE', 'nxp-lx2xxx ${BSP_NXP_LX2XXX_DERIVED}', '${LAYERDIR}/recipes-*/*/*.bbappend', '', d)}"

BBFILE_COLLECTIONS += "wr-nxp-lx2xxx"
BBFILE_PATTERN_wr-nxp-lx2xxx := "^${LAYERDIR}/"
BBFILE_PRIORITY_wr-nxp-lx2xxx = "7"

# This should only be incremented on significant changes that will
# cause compatibility issues with other layers
LAYERVERSION_wr-nxp-lx2xxx = "1"

LAYERDEPENDS_wr-nxp-lx2xxx = "core wrlinux freescale-layer"

LAYERSERIES_COMPAT_wr-nxp-lx2xxx = "thud wrl zeus"
```

## conf/machine/nxp-lx2xxx.conf
```bitbake
#@TYPE: Machine
#@NAME: nxp-lx2xxx
#@DESCRIPTION: Machine configuration for NXP Layerscape LX2160A SoC

DEFAULTTUNE = "cortexa72"
require conf/machine/include/arm/armv8a/tune-cortexa72.inc

MACHINE_FEATURES = "ext3 pci usbgadget usbhost vfat"

KERNEL_IMAGETYPE = "Image"
KERNEL_DEVICETREE = "freescale/fsl-lx2160a-rdb.dtb"

SERIAL_CONSOLES ?= "115200;ttyS0"
SERIAL_CONSOLES_CHECK ?= "${SERIAL_CONSOLES}"

IMAGE_FSTYPES += "tar.bz2"

# multilib support
MULTILIBS ?= "multilib:lib32"
DEFAULTTUNE:virtclass-multilib-lib32 ?= "armv7athf-neon"
EXTRA_IMAGECMD_jffs2 = "--pad --no-cleanmarkers --eraseblock=128"

MACHINE_EXTRA_RRECOMMENDS = " kernel-modules kernel-devicetree"
IMAGE_FSTYPES += "tar.bz2 wic wic.bmap"
WKS_FILE ?= "lx2xxx-sdimage-bootpart.wks"
IMAGE_INSTALL:append = " kernel-devicetree kernel-image-image"
do_image_wic[depends] += "mtools-native:do_populate_sysroot dosfstools-native:do_populate_sysroot"
IMAGE_BOOT_FILES ?= " Image fsl-lx2160a-rdb.dtb"

# it's used by many recipes in meta-freescale
MACHINE_SOCARCH = "${TUNE_PKGARCH}"
BSP_NXP_DERIVED:append:nxp-lx2xxx = " nxp-lx2xxx"
PREFERRED_PROVIDER_virtual/kernel ??= "linux-yocto"
PREFERRED_VERSION_linux-yocto ?= "5.15%"
PREFERRED_VERSION_dpdk = "20.11"

# The loader is flashed into the device separately and not part of the SD image
OSTREE_BOOTLOADER_INCLUDE ?= ""
OSTREE_SD_UBOOT_WIC1 ?= ""
OSTREE_SD_UBOOT_WIC2 ?= ""
OSTREE_SD_UBOOT_WIC3 ?= ""
OSTREE_SD_UBOOT_WIC4 ?= ""

DEFAULT_DTB = "fsl-lx2160a-rdb.dtb"

OSTREE_SD_BOOT_ALIGN ?= "61440"
OSTREE_WKS_EFI_SIZE ?= "--size=64M"
OSTREE_FDISK_BLM ?= "122880"
# Because of the size of the offset being 122880 which is ~64M, 64 must be added
# to 64
OSTREE_FDISK_FSZ ?= "128"

OSTREE_UBOOT_CMD ?= "booti"
INITRAMFS_IMAGE ??= ""
IMAGE_BOOT_FILES:append = " \
    ${@bb.utils.contains('DISTRO_FEATURES', 'ostree', 'boot.scr', '', d)} \
    ${@bb.utils.contains('DISTRO_FEATURES', 'ostree', '${INITRAMFS_IMAGE}-${MACHINE}.${INITRAMFS_FSTYPES};initramfs', '', d)} \
"
OSTREE_KERNEL ?= "Image"
OSTREE_COPY_IMAGE_BOOT_FILES = "1"
OSTREE_BOOTSCR_PRECMD ?= "\
mmc read 0x80d00000 0x6800 0x800; \
fsl_mc lazyapply dpl 0x80d00000; \
setenv initrd_addr 0xb0000000; \
setenv fdt_addr 0x90000000; \
setenv loadaddr 0xa0000000; \
setenv no_menu yes; \
setenv console ttyAMA0; \
setenv no_fatwrite yes; \
"

# For ustart.img
OSTREE_NETINST_DEV ?= "/dev/mmcblk0,/dev/sda,/dev/vda"
OSTREE_NETINST_ARGS ?= " \
    ${OSTREE_CONSOLE} bl=ufsd rdinit=/install \
    instdev=${OSTREE_NETINST_DEV} instname=wrlinux \
    instbr=\$BRANCH insturl=\$URL instab=${OSTREE_USE_AB} \
    instsf=1 instdate=BUILD_DATE \
"
```

## wic/lx2xxx-sdimage-bootpart.wks
```
# short-description: Create SD card image with a boot partition
# long-description: Creates a partitioned SD card image. Boot files
# are located in the first vfat partition.

part u-boot --source rawcopy --sourceparams="file=firmware_lx2160ardb-rev2_uboot_sdboot.img" --ondisk mmcblk0 --no-table --align 4
part /boot --source bootimg-partition --ondisk mmcblk0 --fstype=vfat --label boot --active --align 4 --size 16
part / --source rootfs --ondisk mmcblk0 --fstype=ext4 --label root --align 4
```
